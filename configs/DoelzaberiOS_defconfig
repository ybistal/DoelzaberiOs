## configs/DoelzaberiOS_defconfig
```kconfig
BR2_x86_64=y
BR2_x86_corei7=y
BR2_TOOLCHAIN_BUILDROOT_VENDOR="doelzaberi"
BR2_TOOLCHAIN_BUILDROOT_MUSL=y
BR2_GCC_VERSION_16_X=y
BR2_TOOLCHAIN_BUILDROOT_CXX=y
BR2_TARGET_OPTIMIZATION="-march=x86-64 -mtune=generic -O2 -pipe"
BR2_CCACHE=y
BR2_TARGET_GENERIC_HOSTNAME="doelzaberi"
BR2_TARGET_GENERIC_ISSUE="Welcome to DoelzaberiOS"
BR2_INIT_OPENRC=y
BR2_ROOTFS_MERGED_USR=y
BR2_TARGET_GENERIC_ROOT_PASSWD="doelzaberi"
BR2_SYSTEM_BIN_SH_BASH=y
BR2_TARGET_GENERIC_GETTY_PORT="tty1"
BR2_TARGET_GENERIC_GETTY_TERM="linux"
BR2_SYSTEM_DHCP="eth0"
BR2_SYSTEM_DEFAULT_PATH="/bin:/sbin:/usr/bin:/usr/sbin"
BR2_ENABLE_LOCALE_WHITELIST="C en_US ru_RU"
BR2_SYSTEM_ENABLE_NLS=y
BR2_TARGET_TZ_INFO=y
BR2_TARGET_LOCALTIME="Europe/Moscow"
BR2_ROOTFS_OVERLAY="board/doelzaberi/rootfs-overlay"
BR2_ROOTFS_POST_BUILD_SCRIPT="board/doelzaberi/post-build.sh"
BR2_ROOTFS_POST_IMAGE_SCRIPT="board/doelzaberi/post-image.sh"
BR2_LINUX_KERNEL=y
BR2_LINUX_KERNEL_DEFCONFIG="x86_64"
BR2_LINUX_KERNEL_CONFIG_FRAGMENT_FILES="board/doelzaberi/linux-btrfs.fragment board/doelzaberi/linux-nouveau.fragment board/doelzaberi/linux-storage.fragment board/doelzaberi/linux-drm.fragment"
BR2_LINUX_KERNEL_INSTALL_TARGET=y
BR2_PACKAGE_BTRFS_PROGS=y
BR2_PACKAGE_E2FSPROGS=y
BR2_PACKAGE_DOSFSTOOLS=y
BR2_PACKAGE_DOSFSTOOLS_FATLABEL=y
BR2_PACKAGE_DOSFSTOOLS_FSCK_FAT=y
BR2_PACKAGE_DOSFSTOOLS_MKFS_FAT=y
BR2_PACKAGE_GPTFDISK=y
BR2_PACKAGE_GPTFDISK_GDISK=y
BR2_PACKAGE_GPTFDISK_SGDISK=y
BR2_PACKAGE_UTIL_LINUX_CFDISK=y
BR2_PACKAGE_UTIL_LINUX_PARTX=y
BR2_PACKAGE_OPENDOAS=y
BR2_PACKAGE_FISH=y
BR2_PACKAGE_FASTFETCH=y
BR2_PACKAGE_DEJAVU=y
BR2_PACKAGE_MESA3D=y
BR2_PACKAGE_MESA3D_GALLIUM_DRIVER_IRIS=y
BR2_PACKAGE_MESA3D_GALLIUM_DRIVER_RADEONSI=y
BR2_PACKAGE_MESA3D_GALLIUM_DRIVER_NOUVEAU=y
BR2_PACKAGE_MESA3D_GALLIUM_DRIVER_SOFTPIPE=y
BR2_PACKAGE_MESA3D_GALLIUM_DRIVER_LLVMPIPE=y
BR2_PACKAGE_MESA3D_OPENGL_EGL=y
BR2_PACKAGE_MESA3D_OPENGL_ES=y
BR2_PACKAGE_XKEYBOARD_CONFIG=y
BR2_PACKAGE_FONTCONFIG=y
BR2_PACKAGE_WAYLAND=y
BR2_PACKAGE_LIBXKBCOMMON=y
BR2_PACKAGE_DHCPCD=y
BR2_PACKAGE_DROPBEAR=y
BR2_PACKAGE_GIT=y
BR2_PACKAGE_IPROUTE2=y
BR2_PACKAGE_IPTABLES=y
BR2_PACKAGE_IWD=y
BR2_PACKAGE_WGET=y
BR2_PACKAGE_EFIBOOTMGR=y
BR2_PACKAGE_NANO=y
BR2_PACKAGE_CA_CERTIFICATES=y
BR2_PACKAGE_OPENSSL=y
BR2_PACKAGE_LIBCURL=y
BR2_PACKAGE_LIBCURL_CURL=y
BR2_PACKAGE_LIBCURL_OPENSSL=y
BR2_ROOTFS_DEVICE_CREATION_DYNAMIC_EUDEV=y
BR2_PACKAGE_EUDEV=y
BR2_PACKAGE_DBUS=y
BR2_PACKAGE_SEATD=y
BR2_PACKAGE_SEATD_BUILTIN=y
BR2_PACKAGE_SEATD_DAEMON=y
BR2_PACKAGE_LIBINPUT=y
BR2_PACKAGE_WESTON=y
BR2_PACKAGE_WESTON_DEFAULT_DRM=y
BR2_PACKAGE_WESTON_SHELL_DESKTOP=y
BR2_PACKAGE_WESTON_SIMPLE_CLIENTS=y
BR2_PACKAGE_WESTON_DEMO_CLIENTS=y
BR2_PACKAGE_NIRI=y
BR2_PACKAGE_ALACRITTY=y
BR2_PACKAGE_MAKE=y
BR2_PACKAGE_BINUTILS=y
BR2_PACKAGE_BINUTILS_TARGET=y
BR2_PACKAGE_TCC=y
BR2_PACKAGE_PKGCONF=y
BR2_PACKAGE_UNZIP=y
BR2_PACKAGE_ZIG=y
BR2_PACKAGE_CMAKE_CTEST=y
BR2_PACKAGE_LINUX_FIRMWARE=y
BR2_PACKAGE_LINUX_FIRMWARE_AMD_UCODE=y
BR2_PACKAGE_LINUX_FIRMWARE_AMDGPU=y
BR2_PACKAGE_LINUX_FIRMWARE_I915=y
BR2_PACKAGE_LINUX_FIRMWARE_XE=y
BR2_PACKAGE_LINUX_FIRMWARE_RADEON=y
BR2_TARGET_ROOTFS_ISO9660=y
BR2_TARGET_ROOTFS_TAR_GZIP=y
BR2_TARGET_ROOTFS_CPIO=y
BR2_TARGET_ROOTFS_CPIO_GZIP=y
BR2_LINUX_KERNEL_XZ=y
BR2_TARGET_GRUB2=y
BR2_TARGET_GRUB2_X86_64_EFI=y
BR2_TARGET_GRUB2_BUILTIN_MODULES_EFI="boot linux btrfs ext2 fat iso9660 search search_fs_file search_label test part_gpt part_msdos normal efi_gop efi_uga"
BR2_TARGET_GRUB2_BUILTIN_CONFIG_EFI="board/doelzaberi/grub-efi.cfg"
BR2_TARGET_GRUB2_INSTALL_TOOLS=y
BR2_PACKAGE_HOST_GENIMAGE=y
BR2_PACKAGE_HOST_XORRISO=y
```

## package/alacritty/Config.in
```kconfig
config BR2_PACKAGE_ALACRITTY
	bool "alacritty"
	depends on BR2_USE_MMU
	depends on BR2_TOOLCHAIN_HAS_THREADS
	depends on BR2_INSTALL_LIBSTDCPP
	select BR2_PACKAGE_FREETYPE
	select BR2_PACKAGE_FONTCONFIG
	select BR2_PACKAGE_LIBXKBCOMMON
	select BR2_PACKAGE_WAYLAND
	help
	  Alacritty is a modern terminal emulator that comes with sensible
	  defaults, but allows for extensive configuration.

	  https://github.com/alacritty/alacritty
```

## package/aquamarine/Config.in
```kconfig
config BR2_PACKAGE_AQUAMARINE
	bool "aquamarine"
	depends on BR2_INSTALL_LIBSTDCPP
	depends on BR2_TOOLCHAIN_HAS_THREADS
	depends on BR2_USE_MMU
	select BR2_PACKAGE_HYPRUTILS
	select BR2_PACKAGE_HWDATA
	select BR2_PACKAGE_LIBDISPLAY_INFO
	select BR2_PACKAGE_LIBDRM
	select BR2_PACKAGE_LIBINPUT
	select BR2_PACKAGE_LIBXKBCOMMON
	select BR2_PACKAGE_MESA3D
	select BR2_PACKAGE_MESA3D_GBM
	select BR2_PACKAGE_PIXMAN
	select BR2_PACKAGE_SEATD
	select BR2_PACKAGE_WAYLAND
	select BR2_PACKAGE_WAYLAND_PROTOCOLS
	select BR2_PACKAGE_HOST_HYPRWAYLAND_SCANNER
	help
	  A very light linux rendering backend library. It is the rendering
	  and DRM backend used by the Hyprland compositor.

	  https://github.com/hyprwm/aquamarine
```

## package/fastfetch/Config.in
```kconfig
config BR2_PACKAGE_FASTFETCH
	bool "fastfetch"
	depends on BR2_USE_MMU
	help
	  Fastfetch is a neofetch-like tool for fetching system
	  information and displaying it in a pretty way. It is
	  written in C and does not depend on any interpreter.

	  https://github.com/fastfetch-cli/fastfetch
```

## package/fish/Config.in
```kconfig
config BR2_PACKAGE_FISH
	bool "fish"
	depends on BR2_INSTALL_LIBSTDCPP
	depends on BR2_TOOLCHAIN_HAS_THREADS
	depends on BR2_USE_MMU # fork()
	depends on BR2_USE_WCHAR
	select BR2_PACKAGE_NCURSES
	select BR2_PACKAGE_NCURSES_WCHAR
	select BR2_PACKAGE_PCRE2
	select BR2_PACKAGE_PCRE2_32
	help
	  fish is a smart and user-friendly command line shell for Linux and
	  other Unix-like operating systems.

	  https://fishshell.com/
```

## package/hyprcursor/Config.in
```kconfig
config BR2_PACKAGE_HYPRCURSOR
	bool "hyprcursor"
	depends on BR2_INSTALL_LIBSTDCPP
	select BR2_PACKAGE_CAIRO
	select BR2_PACKAGE_HYPRLANG
	select BR2_PACKAGE_LIBRSVG
	select BR2_PACKAGE_LIBZIP
	select BR2_PACKAGE_TOMLPLUSPLUS
	help
	  A library and toolkit for the Hyprland cursor format.

	  https://github.com/hyprwm/hyprcursor
```

## package/hyprgraphics/Config.in
```kconfig
config BR2_PACKAGE_HYPRGRAPHICS
	bool "hyprgraphics"
	depends on BR2_INSTALL_LIBSTDCPP
	select BR2_PACKAGE_CAIRO
	select BR2_PACKAGE_CAIRO_PNG
	select BR2_PACKAGE_HYPRUTILS
	select BR2_PACKAGE_JPEG
	select BR2_PACKAGE_LIBPNG
	select BR2_PACKAGE_PANGO
	select BR2_PACKAGE_WEBP
	help
	  Small C++ library for graphics and resource utilities used across
	  the Hypr* ecosystem.

	  https://github.com/hyprwm/hyprgraphics
```

## package/hyprland-protocols/Config.in
```kconfig
config BR2_PACKAGE_HYPRLAND_PROTOCOLS
	bool "hyprland-protocols"
	help
	  Wayland protocol extensions used by the Hyprland compositor.

	  https://github.com/hyprwm/hyprland-protocols
```

## package/hyprland/Config.in
```kconfig
config BR2_PACKAGE_HYPRLAND
	bool "hyprland"
	depends on BR2_INSTALL_LIBSTDCPP
	depends on BR2_TOOLCHAIN_HAS_THREADS
	depends on BR2_TOOLCHAIN_GCC_AT_LEAST_10
	depends on !BR2_STATIC_LIBS
	depends on BR2_USE_MMU
	depends on BR2_PACKAGE_XORG7
	select BR2_PACKAGE_AQUAMARINE
	select BR2_PACKAGE_CAIRO
	select BR2_PACKAGE_HYPRCURSOR
	select BR2_PACKAGE_HYPRGRAPHICS
	select BR2_PACKAGE_HYPRLANG
	select BR2_PACKAGE_HYPRLAND_PROTOCOLS
	select BR2_PACKAGE_HYPRUTILS
	select BR2_PACKAGE_LIBDISPLAY_INFO
	select BR2_PACKAGE_LIBDRM
	select BR2_PACKAGE_LIBINPUT
	select BR2_PACKAGE_LIBXKBCOMMON
	select BR2_PACKAGE_MESA3D
	select BR2_PACKAGE_MESA3D_GBM
	select BR2_PACKAGE_PANGO
	select BR2_PACKAGE_PIXMAN
	select BR2_PACKAGE_RE2
	select BR2_PACKAGE_LIBABSEIL_CPP
	select BR2_PACKAGE_SEATD
	select BR2_PACKAGE_UDIS86
	select BR2_PACKAGE_UTIL_LINUX_LIBUUID
	select BR2_PACKAGE_WAYLAND
	select BR2_PACKAGE_WAYLAND_PROTOCOLS
	select BR2_PACKAGE_XLIB_LIBXCURSOR
	help
	  Hyprland is an independent, highly customizable, dynamic tiling
	  Wayland compositor that does not sacrifice on its looks.

	  https://github.com/hyprwm/Hyprland
```

## package/hyprlang/Config.in
```kconfig
config BR2_PACKAGE_HYPRLANG
	bool "hyprlang"
	depends on BR2_INSTALL_LIBSTDCPP
	select BR2_PACKAGE_HYPRUTILS
	help
	  A library to parse hypr config files.

	  https://github.com/hyprwm/hyprlang
```

## package/hyprutils/Config.in
```kconfig
config BR2_PACKAGE_HYPRUTILS
	bool "hyprutils"
	depends on BR2_INSTALL_LIBSTDCPP
	help
	  Small C++ library for utilities used across the Hypr* ecosystem.

	  https://github.com/hyprwm/hyprutils
```

## package/hyprwayland-scanner/Config.in
```kconfig
config BR2_PACKAGE_HYPRWAYLAND_SCANNER
	bool
	help
	  Wayland protocol scanner for the Hypr* ecosystem. This is a host
	  only tool used to generate C++ protocol bindings at build time.

	  https://github.com/hyprwm/hyprwayland-scanner
```

## package/niri/Config.in
```kconfig
config BR2_PACKAGE_NIRI
	bool "niri"
	depends on BR2_USE_MMU
	depends on BR2_TOOLCHAIN_HAS_THREADS
	depends on BR2_INSTALL_LIBSTDCPP
	select BR2_PACKAGE_DBUS
	select BR2_PACKAGE_FONTCONFIG
	select BR2_PACKAGE_FREETYPE
	select BR2_PACKAGE_LIBDISPLAY_INFO
	select BR2_PACKAGE_LIBDRM
	select BR2_PACKAGE_LIBINPUT
	select BR2_PACKAGE_LIBXKBCOMMON
	select BR2_PACKAGE_PANGO
	select BR2_PACKAGE_WAYLAND
	help
	  Niri is a scrollable-tiling Wayland compositor.

	  https://github.com/YaLTeR/niri
```

## package/tcc/Config.in
```kconfig
config BR2_PACKAGE_TCC
	bool "tcc"
	depends on BR2_USE_MMU
	help
	  Tiny C Compiler, a small and fast C compiler.
```

## package/tomlplusplus/Config.in
```kconfig
config BR2_PACKAGE_TOMLPLUSPLUS
	bool "tomlplusplus"
	help
	  TOML++ is a header-only TOML config file parser and serializer
	  for C++17 and later.

	  https://github.com/marzer/tomlplusplus
```

## package/udis86/Config.in
```kconfig
config BR2_PACKAGE_UDIS86
	bool "udis86"
	help
	  udis86 is a disassembler library for the x86 and x86-64
	  instruction sets.

	  https://github.com/canihavesomecoffee/udis86
```

## package/zig/Config.in
```kconfig
config BR2_PACKAGE_ZIG
	bool "zig"
	depends on BR2_USE_MMU
	help
	  Zig is a general purpose programming language and toolchain.
	  The toolchain ships a complete C and C++ compiler (zig cc and
	  zig c++), so programs can be built directly on the target.
```
